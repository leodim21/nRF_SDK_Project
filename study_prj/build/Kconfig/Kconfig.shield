## study_prj/build/Kconfig/Kconfig.shield
```kconfig
osource "/Users/leodim21/Workbanch/Prog_Nordic/adc_spi_led_test_project/study_prj/boards/shields/*/Kconfig.shield"
osource "/opt/nordic/ncs/v2.2.0/nrf/boards/shields/*/Kconfig.shield"
```

## study_prj/build/Kconfig/Kconfig.shield.defconfig
```kconfig
osource "/Users/leodim21/Workbanch/Prog_Nordic/adc_spi_led_test_project/study_prj/boards/shields/*/Kconfig.defconfig"
osource "/opt/nordic/ncs/v2.2.0/nrf/boards/shields/*/Kconfig.defconfig"
```
